## CMakeLists.txt
```
#
# Copyright (c) 2020 Nordic Semiconductor
#
# SPDX-License-Identifier: LicenseRef-Nordic-5-Clause
#

cmake_minimum_required(VERSION 3.20.0)

find_package(Zephyr REQUIRED HINTS $ENV{ZEPHYR_BASE})
project(radio_test)

# Application sources
FILE(GLOB app_sources src/*.c)

# NORDIC SDK APP START
target_sources(app PRIVATE
  ${app_sources}
)
# NORDIC SDK APP END
```

## prj.conf
```kconfig
#
# Copyright (c) 2020 Nordic Semiconductor
#
# SPDX-License-Identifier: LicenseRef-Nordic-5-Clause
#

CONFIG_CONSOLE_HANDLER=y
CONFIG_SHELL=y

CONFIG_DYNAMIC_INTERRUPTS=y

CONFIG_NRFX_TIMER=y
CONFIG_NRFX_GPPI=y
CONFIG_CLOCK_CONTROL=y
CONFIG_FLASH=y
CONFIG_FLASH_MAP=y
CONFIG_NVS=y
CONFIG_SETTINGS=y
CONFIG_SETTINGS_NVS=y
CONFIG_HWINFO=y
CONFIG_MPU_ALLOW_FLASH_WRITE=y

CONFIG_ENTROPY_GENERATOR=y
CONFIG_NRF_SECURITY=y

CONFIG_FEM_AL_LIB=y
CONFIG_PICOLIBC_IO_FLOAT=y
CONFIG_SHELL_BACKEND_SERIAL_RX_RING_BUFFER_SIZE=1024

# --- ADDED TO FIX USAGE FAULT (STACK OVERFLOW) ---
CONFIG_SHELL_STACK_SIZE=4096
```

## src/main.c
```c
/*
 * Copyright (c) 2020 Nordic Semiconductor ASA
 *
 * SPDX-License-Identifier: LicenseRef-Nordic-5-Clause
 */

#include <zephyr/sys/printk.h>
#include <zephyr/device.h>
#include <zephyr/drivers/gpio.h>
#include <zephyr/drivers/clock_control.h>
#include <zephyr/drivers/clock_control/nrf_clock_control.h>
#include <zephyr/kernel.h>
#include <zephyr/pm/device_runtime.h>
#if defined(NRF54L15_XXAA)
#include <hal/nrf_clock.h>
#endif /* defined(NRF54L15_XXAA) */
#if defined(CONFIG_CLOCK_CONTROL_NRF2)
#include <hal/nrf_lrcconf.h>
#endif
#include <nrfx.h>
#if NRF54L_ERRATA_20_PRESENT
#include <hal/nrf_power.h>
#endif /* NRF54L_ERRATA_20_PRESENT */
#if defined(NRF54LM20A_ENGA_XXAA)
#include <hal/nrf_clock.h>
#endif /* defined(NRF54LM20A_ENGA_XXAA) */

#include "radio_node.h"

/* Empty trim value */
#define TRIM_VALUE_EMPTY 0xFFFFFFFF

#define LED0_NODE DT_ALIAS(led0)
#define SW0_NODE DT_ALIAS(sw0)

#if DT_NODE_HAS_STATUS(LED0_NODE, okay)
static const struct gpio_dt_spec status_led = GPIO_DT_SPEC_GET(LED0_NODE, gpios);
static struct k_work_delayable led_work;
static bool led_blink_state;
#endif

#if DT_NODE_HAS_STATUS(SW0_NODE, okay)
static const struct gpio_dt_spec user_button = GPIO_DT_SPEC_GET(SW0_NODE, gpios);
static struct gpio_callback button_cb_data;
static struct k_work button_work;
static int64_t last_button_press_ms;
#endif

#if DT_NODE_HAS_STATUS(LED0_NODE, okay)
static void led_work_handler(struct k_work *work)
{
	ARG_UNUSED(work);

	if (!device_is_ready(status_led.port)) {
		return;
	}

	if (radio_node_led_should_blink()) {
		led_blink_state = !led_blink_state;
		gpio_pin_set_dt(&status_led, led_blink_state ? 1 : 0);
	} else {
		led_blink_state = false;
		gpio_pin_set_dt(&status_led, radio_node_led_should_be_on() ? 1 : 0);
	}

	k_work_reschedule(&led_work, K_MSEC(250));
}
#endif

#if DT_NODE_HAS_STATUS(SW0_NODE, okay)
static void button_work_handler(struct k_work *work)
{
	ARG_UNUSED(work);
	radio_node_handle_button_press();
}

static void button_pressed(const struct device *dev, struct gpio_callback *cb,
			   uint32_t pins)
{
	ARG_UNUSED(dev);
	ARG_UNUSED(cb);

	if ((pins & BIT(user_button.pin)) == 0u) {
		return;
	}

	if ((k_uptime_get() - last_button_press_ms) < 250) {
		return;
	}

	last_button_press_ms = k_uptime_get();
	k_work_submit(&button_work);
}
#endif

static void node_ui_init(void)
{
#if DT_NODE_HAS_STATUS(LED0_NODE, okay)
	if (gpio_is_ready_dt(&status_led)) {
		gpio_pin_configure_dt(&status_led, GPIO_OUTPUT_INACTIVE);
		k_work_init_delayable(&led_work, led_work_handler);
		k_work_reschedule(&led_work, K_NO_WAIT);
	} else {
		printk("Status LED not ready\n");
	}
#endif

#if DT_NODE_HAS_STATUS(SW0_NODE, okay)
	if (gpio_is_ready_dt(&user_button)) {
		int err;

		k_work_init(&button_work, button_work_handler);
		err = gpio_pin_configure_dt(&user_button, GPIO_INPUT);
		if (err == 0) {
			err = gpio_pin_interrupt_configure_dt(&user_button, GPIO_INT_EDGE_TO_ACTIVE);
		}
		if (err == 0) {
			gpio_init_callback(&button_cb_data, button_pressed, BIT(user_button.pin));
			err = gpio_add_callback(user_button.port, &button_cb_data);
		}
		if (err != 0) {
			printk("Button init failed: %d\n", err);
		}
	} else {
		printk("User button not ready\n");
	}
#endif
}

#if defined(CONFIG_CLOCK_CONTROL_NRF)
static void clock_init(void)
{
	int err;
	int res;
	struct onoff_manager *clk_mgr;
	struct onoff_client clk_cli;

	clk_mgr = z_nrf_clock_control_get_onoff(CLOCK_CONTROL_NRF_SUBSYS_HF);
	if (!clk_mgr) {
		printk("Unable to get the Clock manager\n");
		return;
	}

	sys_notify_init_spinwait(&clk_cli.notify);

	err = onoff_request(clk_mgr, &clk_cli);
	if (err < 0) {
		printk("Clock request failed: %d\n", err);
		return;
	}

	do {
		err = sys_notify_fetch_result(&clk_cli.notify, &res);
		if (!err && res) {
			printk("Clock could not be started: %d\n", res);
			return;
		}
	} while (err);

#if NRF54L_ERRATA_20_PRESENT
	if (nrf54l_errata_20()) {
		nrf_power_task_trigger(NRF_POWER, NRF_POWER_TASK_CONSTLAT);
	}
#endif /* NRF54L_ERRATA_20_PRESENT */

#if defined(NRF54LM20A_ENGA_XXAA)
	/* MLTPAN-39 */
	nrf_clock_task_trigger(NRF_CLOCK, NRF_CLOCK_TASK_PLLSTART);
#endif /* defined(NRF54LM20A_ENGA_XXAA) */

	printk("Clock has started\n");
}

#elif defined(CONFIG_CLOCK_CONTROL_NRF2)

static void clock_init(void)
{
	int err;
	int res;
	const struct device *radio_clk_dev =
		DEVICE_DT_GET_OR_NULL(DT_CLOCKS_CTLR(DT_NODELABEL(radio)));
	struct onoff_client radio_cli;

	/** Keep radio domain powered all the time to reduce latency. */
	nrf_lrcconf_poweron_force_set(NRF_LRCCONF010, NRF_LRCCONF_POWER_DOMAIN_1, true);

	sys_notify_init_spinwait(&radio_cli.notify);

	err = nrf_clock_control_request(radio_clk_dev, NULL, &radio_cli);

	do {
		err = sys_notify_fetch_result(&radio_cli.notify, &res);
		if (!err && res) {
			printk("Clock could not be started: %d\n", res);
			return;
		}
	} while (err == -EAGAIN);

	printk("Clock has started\n");
}

#if defined(CONFIG_SOC_SERIES_NRF54HX)
static void nrf54hx_radio_trim(void)
{
	/* Apply HMPAN-102 workaround for nRF54H series */
	*(volatile uint32_t *)0x5302C7E4 =
				(((*((volatile uint32_t *)0x5302C7E4)) & 0xFF000FFF) | 0x0012C000);

	/* Apply HMPAN-18 workaround for nRF54H series - load trim values*/
	if (*(volatile uint32_t *) 0x0FFFE458 != TRIM_VALUE_EMPTY) {
		*(volatile uint32_t *) 0x5302C734 = *(volatile uint32_t *) 0x0FFFE458;
	}

	if (*(volatile uint32_t *) 0x0FFFE45C != TRIM_VALUE_EMPTY) {
		*(volatile uint32_t *) 0x5302C738 = *(volatile uint32_t *) 0x0FFFE45C;
	}

	if (*(volatile uint32_t *) 0x0FFFE460 != TRIM_VALUE_EMPTY) {
		*(volatile uint32_t *) 0x5302C73C = *(volatile uint32_t *) 0x0FFFE460;
	}

	if (*(volatile uint32_t *) 0x0FFFE464 != TRIM_VALUE_EMPTY) {
		*(volatile uint32_t *) 0x5302C740 = *(volatile uint32_t *) 0x0FFFE464;
	}

	if (*(volatile uint32_t *) 0x0FFFE468 != TRIM_VALUE_EMPTY) {
		*(volatile uint32_t *) 0x5302C74C = *(volatile uint32_t *) 0x0FFFE468;
	}

	if (*(volatile uint32_t *) 0x0FFFE46C != TRIM_VALUE_EMPTY) {
		*(volatile uint32_t *) 0x5302C7D8 = *(volatile uint32_t *) 0x0FFFE46C;
	}

	if (*(volatile uint32_t *) 0x0FFFE470 != TRIM_VALUE_EMPTY) {
		*(volatile uint32_t *) 0x5302C840 = *(volatile uint32_t *) 0x0FFFE470;
	}

	if (*(volatile uint32_t *) 0x0FFFE474 != TRIM_VALUE_EMPTY) {
		*(volatile uint32_t *) 0x5302C844 = *(volatile uint32_t *) 0x0FFFE474;
	}

	if (*(volatile uint32_t *) 0x0FFFE478 != TRIM_VALUE_EMPTY) {
		*(volatile uint32_t *) 0x5302C848 = *(volatile uint32_t *) 0x0FFFE478;
	}

	if (*(volatile uint32_t *) 0x0FFFE47C != TRIM_VALUE_EMPTY) {
		*(volatile uint32_t *) 0x5302C84C = *(volatile uint32_t *) 0x0FFFE47C;
	}

	/* Apply HMPAN-103 workaround for nRF54H series*/
	if ((*(volatile uint32_t *) 0x5302C8A0 == 0x80000000) ||
		(*(volatile uint32_t *) 0x5302C8A0 == 0x0058120E)) {
		*(volatile uint32_t *) 0x5302C8A0 = 0x0058090E;
	}

	*(volatile uint32_t *) 0x5302C8A4 = 0x00F8AA5F;
	*(volatile uint32_t *) 0x5302C7AC = 0x8672827A;
	*(volatile uint32_t *) 0x5302C7B0 = 0x7E768672;
	*(volatile uint32_t *) 0x5302C7B4 = 0x0406007E;
}
#endif /* defined(CONFIG_SOC_SERIES_NRF54HX) */

#else
BUILD_ASSERT(false, "No Clock Control driver");
#endif /* defined(CONFIG_CLOCK_CONTROL_NRF) */

int main(void)
{
	printk("Starting Radio Test sample\n");

#if defined(CONFIG_SOC_SERIES_NRF54HX)
	const struct device *console_uart = DEVICE_DT_GET_OR_NULL(DT_CHOSEN(zephyr_console));
	const struct device *shell_uart = DEVICE_DT_GET_OR_NULL(DT_CHOSEN(zephyr_shell_uart));

	if (console_uart != NULL) {
		int ret = pm_device_runtime_get(console_uart);

		if (ret < 0) {
			printk("Failed to get console UART runtime PM: %d\n", ret);
		}
	}

	if (shell_uart != NULL && shell_uart != console_uart) {
		int ret = pm_device_runtime_get(shell_uart);

		if (ret < 0) {
			printk("Failed to get shell UART runtime PM: %d\n", ret);
		}
	}
#endif /* defined(CONFIG_SOC_SERIES_NRF54HX) */

	clock_init();
	node_ui_init();

#if defined(CONFIG_SOC_SERIES_NRF54HX)
	nrf54hx_radio_trim();
#endif

	return 0;
}
```

## src/local_config.h
```c
#define VERBOSE_LOGGING 0 //Set 1 to output verbose logging, 0 to disable. Verbose logging includes additional information about received frames and other events, which can be helpful for debugging and analysis.
#define VERBOSE_LOGGING_ALL 0 //Set 1 to output all verbose logging, including very detailed information about received frames, which can be useful for in-depth debugging. Set to 0 to disable this level of logging.
#define HALT_ON_PER_REPORT_NEG2 1 //Set 1 to freeze the device immediately after emitting a -2 PER_REPORT. Set to 0 for normal runtime behavior.
```

## src/radio_node.h
```c
#ifndef RADIO_NODE_H_
#define RADIO_NODE_H_

#include <stdbool.h>

#include "radio_test.h"

enum radio_node_mode {
	RADIO_NODE_MODE_UNASSIGNED = 0,
	RADIO_NODE_MODE_COORDINATOR,
	RADIO_NODE_MODE_RECEIVER,
	RADIO_NODE_MODE_TEST_TX,
};

int radio_node_init(void);

void radio_node_handle_proto_frame(const struct radio_proto_frame *frame);

void radio_node_handle_proto_response_complete(enum radio_proto_cmd cmd,
					       uint32_t dst_signature,
					       uint16_t value,
					       uint32_t aux_signature);

void radio_node_note_proto_frame_activity(uint32_t src_signature);

void radio_node_handle_discover_req(uint32_t src_signature, uint32_t dst_signature);

void radio_node_handle_button_press(void);

enum radio_node_mode radio_node_get_mode(void);

bool radio_node_led_should_blink(void);

bool radio_node_led_should_be_on(void);

#endif /* RADIO_NODE_H_ */
```

## src/radio_test.h
```c
/*
 * Copyright (c) 2020 Nordic Semiconductor ASA
 *
 * SPDX-License-Identifier: LicenseRef-Nordic-5-Clause
 */

#ifndef RADIO_TEST_H_
#define RADIO_TEST_H_

#include <zephyr/types.h>
#include <hal/nrf_radio.h>
#include <fem_al/fem_al.h>

#ifdef NRF53_SERIES
#ifndef RADIO_TXPOWER_TXPOWER_Pos3dBm
	#define RADIO_TXPOWER_TXPOWER_Pos3dBm (0x03UL)
#endif /* RADIO_TXPOWER_TXPOWER_Pos3dBm */

#ifndef RADIO_TXPOWER_TXPOWER_Pos2dBm
	#define RADIO_TXPOWER_TXPOWER_Pos2dBm (0x02UL)
#endif /* RADIO_TXPOWER_TXPOWER_Pos2dBm */

#ifndef RADIO_TXPOWER_TXPOWER_Pos1dBm
	#define RADIO_TXPOWER_TXPOWER_Pos1dBm (0x01UL)
#endif /* RADIO_TXPOWER_TXPOWER_Pos1dBm */
#endif /* NRF53_SERIES */

/** Maximum radio RX or TX payload. */
#define RADIO_MAX_PAYLOAD_LEN	256
/** IEEE 802.15.4 maximum payload length. */
#define IEEE_MAX_PAYLOAD_LEN	127
#define RADIO_PROTO_HEADER_SIZE 20u
#define RADIO_PROTO_BROADCAST_SIG 0xFFFFFFFFu
/** IEEE 802.15.4 minimum channel. */
#define IEEE_MIN_CHANNEL	11
/** IEEE 802.15.4 maximum channel. */
#define IEEE_MAX_CHANNEL	26
#define RADIO_PROTO_MAX_PEERS 64

#define RADIO_SURVEY_PROFILE_TYPE_MASK 0x3u
#define RADIO_SURVEY_PROFILE_AGGREGATOR_BIT 0x4u

#define FEM_USE_DEFAULT_TX_POWER_CONTROL 0xFF

/**@brief Radio transmit and address pattern. */
enum transmit_pattern {
	/** Random pattern. */
	TRANSMIT_PATTERN_RANDOM,

	/** Pattern 11110000(F0). */
	TRANSMIT_PATTERN_11110000,

	/** Pattern 11001100(CC). */
	TRANSMIT_PATTERN_11001100,
};

/**@brief Radio test mode. */
enum radio_test_mode {
	/** TX carrier. */
	UNMODULATED_TX,

	/** Modulated TX carrier. */
	MODULATED_TX,

	/** RX carrier. */
	RX,

	/** TX carrier sweep. */
	TX_SWEEP,

	/** RX carrier sweep. */
	RX_SWEEP,

	/** Duty-cycled modulated TX carrier. */
	MODULATED_TX_DUTY_CYCLE,
};

/**@brief Radio test front-end module (FEM) configuration */
struct radio_test_fem {
	/* Front-end module radio ramp-up time in microseconds. */
	uint32_t ramp_up_time;

	/* Front-end module TX power control specific to given front-end module.
	 * For nRF21540 GPIO/SPI, this is a register value.
	 * For nRF21540 GPIO, this is MODE pin value.
	 */
	fem_tx_power_control tx_power_control;
};

/**@brief Radio test configuration. */
struct radio_test_config {
	/** Radio test type. */
	enum radio_test_mode type;

	/** Radio mode. Data rate and modulation. */
	nrf_radio_mode_t mode;

	union {
		struct {
			/** Radio output power. */
			int8_t txpower;

			/** Radio channel. */
			uint8_t channel;
		} unmodulated_tx;

		struct {
			/** Radio output power. */
			int8_t txpower;

			/** Radio transmission pattern. */
			enum transmit_pattern pattern;

			/** Radio channel. */
			uint8_t channel;

			/**
			 * Number of packets to transmit.
			 * Set to zero for continuous TX.
			 */
			uint32_t packets_num;

			/** Callback to indicate that TX is finished. */
			void (*cb)(void);

			/** Inter-packet delay in microseconds. */
			//uint32_t inter_packet_delay_us;
		} modulated_tx;

		struct {
			/** Radio transmission pattern. */
			enum transmit_pattern pattern;

			/** Radio channel. */
			uint8_t channel;

			/**
			 * Number of packets to be received.
			 * Set to zero for continuous RX.
			 */
			uint32_t packets_num;

			/** Callback to indicate that RX is finished. */
			void (*cb)(void);
		} rx;

		struct {
			/** Radio output power. */
			int8_t txpower;

			/** Radio start channel (frequency). */
			uint8_t channel_start;

			/** Radio end channel (frequency). */
			uint8_t channel_end;

			/** Delay time in milliseconds. */
			uint32_t delay_ms;
		} tx_sweep;

		struct {
			/** Radio start channel (frequency). */
			uint8_t channel_start;

			/** Radio end channel (frequency). */
			uint8_t channel_end;

			/** Delay time in milliseconds. */
			uint32_t delay_ms;
		} rx_sweep;

		struct {
			/** Radio output power. */
			int8_t txpower;

			/** Radio transmission pattern. */
			enum transmit_pattern pattern;

			/** Radio channel. */
			uint8_t channel;

			/** Duty cycle. */
			uint32_t duty_cycle;

			/**
			 * Number of packets to transmit.
			 * Set to zero for continuous TX.
			 */
			uint32_t packets_num;

			/** Callback to indicate that TX is finished. */
			void (*cb)(void);
		} modulated_tx_duty_cycle;
	} params;

#if CONFIG_FEM
	/* Front-end module (FEM) configuration. */
	struct radio_test_fem fem;
#endif /* CONFIG_FEM */
};

/**@brief Radio RX statistics. */
struct radio_rx_stats {
	/** Content of the last packet. */
	struct {
		/** Content of the last packet. */
		uint8_t *buf;

		/** Length of the last packet. */
		size_t len;
	} last_packet;

	/** Number of received packets with valid CRC. */
	uint32_t packet_cnt;
};

enum radio_proto_role {
	RADIO_PROTO_ROLE_DISABLED = 0,
	RADIO_PROTO_ROLE_TX,
	RADIO_PROTO_ROLE_RX,
};

enum radio_survey_node_type {
	RADIO_SURVEY_NODE_TYPE_UNKNOWN = 0,
	RADIO_SURVEY_NODE_TYPE_X = 1,
	RADIO_SURVEY_NODE_TYPE_Y = 2,
};

enum radio_proto_cmd {
	RADIO_PROTO_CMD_DISCOVER_REQ = 1,
	RADIO_PROTO_CMD_DISCOVER_RSP,
	RADIO_PROTO_CMD_TEST_DATA,
	RADIO_PROTO_CMD_PER_REQ,
	RADIO_PROTO_CMD_PER_RSP,
	RADIO_PROTO_CMD_CLEAR_PER_REQ,
	RADIO_PROTO_CMD_CLEAR_PER_RSP,
	RADIO_PROTO_CMD_RELEASE_REQ,
	RADIO_PROTO_CMD_RELEASE_RSP,
	RADIO_PROTO_CMD_REMOTE_TEST_REQ,
	RADIO_PROTO_CMD_REMOTE_TEST_REQ_ACK,
	RADIO_PROTO_CMD_REMOTE_TEST_REPORT,
	RADIO_PROTO_CMD_REMOTE_TEST_DONE,
	RADIO_PROTO_CMD_REMOTE_TEST_REPORT_ACK,
	RADIO_PROTO_CMD_REMOTE_TEST_DONE_ACK,
	RADIO_PROTO_CMD_PROVISION_REQ,
	RADIO_PROTO_CMD_PROVISION_RSP,
	RADIO_PROTO_CMD_CONTROL_ACK,
	RADIO_PROTO_CMD_SHARED_LIST_CLEAR,
	RADIO_PROTO_CMD_SHARED_LIST_ADD,
	RADIO_PROTO_CMD_TEST_START,
	RADIO_PROTO_CMD_TEST_END,
	RADIO_PROTO_CMD_SET_CHANNEL,
};

struct radio_proto_frame {
	uint8_t cmd;
	uint8_t flags;
	uint32_t src_signature;
	uint32_t dst_signature;
	uint32_t aux_signature;
	uint16_t value;
	uint8_t payload_len;
};

struct radio_proto_peer {
	uint32_t signature;
	uint32_t rx_test_packets;
	uint16_t reported_rx_packets;
	uint8_t node_type;
	bool is_data_aggregator;
	bool seen_discover_rsp;
	bool seen_per_rsp;
	bool seen_clear_per_rsp;
	bool seen_release_rsp;
};

struct radio_proto_status {
	enum radio_proto_role role;
	uint32_t local_signature;
	uint32_t discover_req_seen;
	uint32_t discover_rsp_seen;
	uint32_t test_data_seen;
	uint32_t per_req_seen;
	uint32_t per_rsp_seen;
	uint32_t local_test_data_rx;
	uint8_t peer_count;
	struct radio_proto_peer peers[RADIO_PROTO_MAX_PEERS];
};

/**
 * @brief Function for initializing the Radio Test module.
 *
 * @param[in] config  Radio test configuration.
 *
 * @retval 0 If the operation was successful.
 *           Otherwise, a (negative) error code is returned.
 */
int radio_test_init(struct radio_test_config *config);

/**
 * @brief Function for starting radio test.
 *
 * @param[in] config  Radio test configuration.
 */
void radio_test_start(const struct radio_test_config *config);

/**
 * @brief Function for stopping ongoing test (Radio and Timer operations).
 *
 * @param[in] type  Radio test mode.
 */
void radio_test_cancel(enum radio_test_mode type);

/**
 * @brief Function for get RX statistics.
 *
 * @param[out] rx_stats RX statistics.
 */
void radio_rx_stats_get(struct radio_rx_stats *rx_stats);

bool radio_test_sample_rssi_dbm(int16_t *rssi_dbm);

/**
 * @brief Function for toggling the DC/DC converter state.
 *
 * @param[in] dcdc_state  DC/DC converter state.
 */
void toggle_dcdc_state(uint8_t dcdc_state);

void radio_proto_set_signature(uint32_t signature);

void radio_proto_set_response_txpower(int8_t txpower);

void radio_proto_set_local_node_profile(enum radio_survey_node_type node_type,
					      bool is_data_aggregator);

void radio_proto_set_role(enum radio_proto_role role);

enum radio_proto_role radio_proto_get_role(void);

bool radio_proto_remote_test_busy(void);

enum radio_survey_node_type radio_proto_get_local_node_type(void);

bool radio_proto_get_local_aggregator(void);

void radio_proto_reset(void);

int radio_proto_prepare_tx(enum radio_proto_cmd cmd, uint32_t dst_signature, uint16_t value);

int radio_proto_prepare_tx_ext(enum radio_proto_cmd cmd, uint32_t dst_signature,
			       uint16_t value, uint32_t aux_signature);

int radio_proto_prepare_tx_ext_sized(enum radio_proto_cmd cmd, uint32_t dst_signature,
				     uint16_t value, uint32_t aux_signature,
				     uint8_t payload_len_field,
				     uint8_t frame_payload_len);

int radio_proto_prepare_tx_raw(enum radio_proto_cmd cmd,
			       uint8_t flags,
			       uint32_t src_signature,
			       uint32_t dst_signature,
			       uint16_t value,
			       uint32_t aux_signature);

int radio_proto_prepare_tx_raw_sized(enum radio_proto_cmd cmd,
				     uint8_t flags,
				     uint32_t src_signature,
				     uint32_t dst_signature,
				     uint16_t value,
				     uint32_t aux_signature,
				     uint8_t payload_len_field,
				     uint8_t frame_payload_len);

void radio_proto_schedule_response(enum radio_proto_cmd cmd, uint32_t dst_signature,
				       uint16_t value);

void radio_proto_schedule_response_ext(enum radio_proto_cmd cmd, uint32_t dst_signature,
				       uint16_t value, uint32_t aux_signature);

void radio_proto_schedule_response_raw(enum radio_proto_cmd cmd,
				      uint8_t flags,
				      uint32_t dst_signature,
				      uint16_t value,
				      uint32_t aux_signature);

void radio_proto_get_status(struct radio_proto_status *status);

uint8_t radio_proto_get_peer_signatures(uint32_t *signatures, uint8_t max_count);

void radio_proto_clear_peer_list(void);

void radio_proto_reset_discover_round(void);

void radio_proto_reset_per_results(void);

void radio_proto_reset_clear_per_results(void);

void radio_proto_reset_release_results(void);

void radio_proto_begin_test_session(uint32_t broadcaster_signature);

void radio_proto_end_test_session(uint32_t broadcaster_signature);

void radio_proto_reset_local_test_counter(void);

#endif /* RADIO_TEST_H_ */
```
